#include "board_mist_icons.h"
#include "board_display_logic.h"

/* Icon matrices from BORING-MIST-UI-Firmware-Handoff-Joey-20260906.
 * Original rows and per-cell brightness retained; the existing 52-glyph
 * BORING 5R text font is deliberately not replaced. */

static const uint16_t icon_00_icon_rows[] = { 2047, 514, 476, 248, 112, 0, 32, 0, 136, 292, 626, 2047 };
static const uint8_t icon_00_icon_levels[] = { 255, 255, 255, 255, 255, 255, 255, 255, 255, 255, 255, 0, 255,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 255, 255 };
static const uint16_t icon_01_icon_rows[] = { 384, 8191, 384, 0, 12, 8191, 12, 0, 1536, 8191, 1536 };
static const uint8_t icon_01_icon_levels[] = { 0, 0, 0, 0, 224, 224, 0, 0, 0, 0, 0, 0, 0,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 0, 0 };
static const uint16_t icon_02_macos_rows[] = { 4387, 6996, 5492, 4436, 4435 };
static const uint8_t icon_02_macos_levels[] = { 255, 0, 0, 0, 255, 0, 0, 255, 0, 0, 0, 255, 255,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 255, 255 };
static const uint16_t icon_03_windows_linux_rows[] = { 8937, 8781, 10827, 13897, 8937 };
static const uint8_t icon_03_windows_linux_levels[] = { 255, 0, 0, 0, 255, 0, 255, 255, 255, 0, 255, 0, 0,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 0, 255 };
static const uint16_t icon_04_icon_rows[] = { 8, 16, 32, 127, 32, 16, 8 };
static const uint8_t icon_04_icon_levels[] = { 0, 0, 0, 255, 0, 0, 0, 0, 0, 255, 0, 0, 0,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 0, 0 };
static const uint16_t icon_05_icon_rows[] = { 1, 2, 4, 520, 272, 160, 64 };
static const uint8_t icon_05_icon_levels[] = { 0, 0, 0, 0, 0, 0, 0, 0, 0, 242, 0, 0, 0,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 0, 0 };
static const uint16_t icon_06_icon_rows[] = { 8, 42, 73, 65, 65, 34, 28 };
static const uint8_t icon_06_icon_levels[] = { 0, 0, 0, 255, 0, 0, 0, 0, 255, 0, 255, 0, 255,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 0, 0 };
static const uint16_t icon_07_icon_rows[] = { 12, 12, 12, 12, 12, 12, 12, 0, 33, 0, 12, 12 };
static const uint8_t icon_07_icon_levels[] = { 0, 0, 222, 222, 0, 0, 0, 0, 222, 222, 0, 0, 0,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 0, 0 };
static const uint16_t icon_08_icon_rows[] = { 16, 24, 28, 30, 28, 24, 16 };
static const uint8_t icon_08_icon_levels[] = { 0, 0, 255, 0, 0, 0, 0, 0, 0, 255, 255, 0, 0,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 0, 0 };
static const uint16_t icon_09_icon_rows[] = { 54, 54, 54, 54, 54, 54, 54 };
static const uint8_t icon_09_icon_levels[] = { 0, 255, 255, 0, 255, 255, 0, 0, 255, 255, 0, 255, 255,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 255, 0 };
static const uint16_t icon_10_icon_rows[] = { 0, 62, 34, 34, 34, 62, 0 };
static const uint8_t icon_10_icon_levels[] = { 0, 0, 0, 0, 0, 0, 0, 0, 255, 255, 255, 255, 255,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 0, 0 };
static const uint16_t icon_11_icon_rows[] = { 257, 130, 68, 40, 16, 40, 68, 130, 257 };
static const uint8_t icon_11_icon_levels[] = { 224, 0, 0, 0, 0, 0, 0, 0, 224, 0, 224, 0, 0,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 0, 224 };
static const uint16_t icon_12_icon_rows[] = { 127, 65, 93, 65, 81, 65, 127 };
static const uint8_t icon_12_icon_levels[] = { 255, 255, 255, 255, 255, 255, 255, 255, 0, 0, 0, 0, 0,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 255, 255 };
static const uint16_t icon_13_icon_rows[] = { 0, 1016, 2044, 2044, 4094, 4094, 4094, 4094, 2044, 2044, 1016, 0 };
static const uint8_t icon_13_icon_levels[] = { 0, 0, 0, 0, 0, 0, 0, 0, 0, 0, 0, 0, 0,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 0, 0 };
static const uint16_t icon_14_icon_rows[] = { 0, 1028, 2274, 4321, 4321, 4321, 4321, 4321, 2274, 1028, 0 };
static const uint8_t icon_14_icon_levels[] = { 0, 0, 0, 0, 0, 0, 0, 0, 0, 0, 0, 0, 0,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 0, 0 };
static const uint16_t icon_15_icon_rows[] = { 0, 32, 96, 96, 112, 120, 127, 62 };
static const uint8_t icon_15_icon_levels[] = { 0, 0, 0, 0, 0, 0, 0, 0, 150, 0, 0, 0, 0,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 207, 0 };
static const uint16_t icon_16_icon_rows[] = { 120, 72, 74, 79, 74, 72, 120 };
static const uint8_t icon_16_icon_levels[] = { 255, 255, 255, 255, 0, 0, 0, 255, 0, 0, 255, 0, 0,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 0, 0 };
static const uint16_t icon_17_icon_rows[] = { 17, 25, 21, 19, 17 };
static const uint8_t icon_17_icon_levels[] = { 255, 0, 0, 0, 255, 255, 255, 0, 0, 255, 255, 0, 255, 0, 255, 255, 0, 0, 255, 255, 255, 0, 0, 0, 255 };
static const uint16_t icon_18_codex_rows[] = { 14, 17, 16, 17, 14 };
static const uint8_t icon_18_codex_levels[] = { 0, 255, 255, 255, 0, 255, 0, 0, 0, 255, 255, 0, 0, 0, 0, 255, 0, 0, 0, 255, 0, 255, 255, 255, 0 };
static const uint16_t icon_19_icon_rows[] = { 1820, 2050, 4097, 4593, 4097, 2050, 1820 };
static const uint8_t icon_19_icon_levels[] = { 0, 0, 204, 204, 204, 0, 0, 0, 204, 204, 204, 0, 0,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 0, 0 };
static const uint16_t icon_20_icon_rows[] = { 16, 504, 2044, 1048, 3088, 2048, 2048, 2048, 3072, 1028, 1820, 496, 0 };
static const uint8_t icon_20_icon_levels[] = { 0, 0, 0, 0, 0, 0, 0, 0, 255, 0, 0, 0, 0,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 0, 0 };
static const uint16_t icon_21_icon_rows[] = { 2015, 1025, 1025, 1137, 1137, 1025, 1025, 2015 };
static const uint8_t icon_21_icon_levels[] = { 179, 179, 179, 179, 179, 0, 179, 179, 179, 179, 179, 179, 0,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 179, 179 };
static const uint16_t icon_22_icon_rows[] = { 0, 1016, 1548, 3078, 2274, 2546, 2546, 2546, 2274, 3078, 1548, 1016, 0 };
static const uint8_t icon_22_icon_levels[] = { 0, 0, 0, 0, 0, 0, 0, 0, 0, 0, 0, 0, 0,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 0, 0 };
static const uint16_t icon_23_codex_rows[] = { 896, 1144, 1028, 6146, 8194, 9217, 16897, 16641, 16897, 17530, 8194, 8194, 4108, 3600, 480 };
static const uint8_t icon_23_codex_levels[] = { 0, 0, 0, 0, 0, 89, 89, 89, 0, 0, 0, 0, 0,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 0, 0 };
static const uint16_t icon_24_claude_code_rows[] = { 2112, 3148, 1112, 9840, 12896, 6848, 4062, 32752, 2046, 8134, 13152, 26224, 3160, 2120, 64 };
static const uint8_t icon_24_claude_code_levels[] = { 0, 0, 0, 255, 0, 0, 0, 0, 255, 0, 0, 0, 0,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 0, 0 };
static const uint16_t icon_25_usb_rows[] = { 64, 224, 496, 64, 1102, 3662, 1092, 1092, 584, 336, 224, 64, 224, 224, 64 };
static const uint8_t icon_25_usb_levels[] = { 0, 0, 0, 0, 0, 0, 255, 0, 0, 0, 0, 0, 0,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 0, 0 };
static const uint16_t icon_26_bluetooth_rows[] = { 16, 24, 20, 274, 148, 88, 48, 48, 88, 148, 274, 20, 24, 16, 0 };
static const uint8_t icon_26_bluetooth_levels[] = { 0, 0, 0, 0, 255, 0, 0, 0, 0, 0, 0, 0, 0,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 0, 0 };

static const uint16_t battery_rows[] = {
    0x0ffe, 0x0802, 0x0ada, 0x0adb, 0x0adb, 0x0adb, 0x0ada, 0x0802, 0x0ffe,
};

static const board_mist_icon_asset_t s_icons[] = {
    { "番茄钟", 11, 12, icon_00_icon_rows, icon_00_icon_levels },
    { "设置", 13, 11, icon_01_icon_rows, icon_01_icon_levels },
    { "macOS", 13, 5, icon_02_macos_rows, icon_02_macos_levels },
    { "Windows / Linux", 14, 5, icon_03_windows_linux_rows, icon_03_windows_linux_levels },
    { "返回", 7, 7, icon_04_icon_rows, icon_04_icon_levels },
    { "确认", 10, 7, icon_05_icon_rows, icon_05_icon_levels },
    { "电源", 7, 7, icon_06_icon_rows, icon_06_icon_levels },
    { "警告", 6, 12, icon_07_icon_rows, icon_07_icon_levels },
    { "播放", 7, 7, icon_08_icon_rows, icon_08_icon_levels },
    { "暂停", 7, 7, icon_09_icon_rows, icon_09_icon_levels },
    { "取消", 7, 7, icon_10_icon_rows, icon_10_icon_levels },
    { "错误", 9, 9, icon_11_icon_rows, icon_11_icon_levels },
    { "配置", 7, 7, icon_12_icon_rows, icon_12_icon_levels },
    { "灯光", 13, 12, icon_13_icon_rows, icon_13_icon_levels },
    { "振动", 13, 11, icon_14_icon_rows, icon_14_icon_levels },
    { "待机", 7, 8, icon_15_icon_rows, icon_15_icon_levels },
    { "退出", 7, 7, icon_16_icon_rows, icon_16_icon_levels },
    { "普通模式", 5, 5, icon_17_icon_rows, icon_17_icon_levels },
    { "Codex", 5, 5, icon_18_codex_rows, icon_18_codex_levels },
    { "蓝牙连接", 13, 7, icon_19_icon_rows, icon_19_icon_levels },
    { "重启", 13, 13, icon_20_icon_rows, icon_20_icon_levels },
    { "系统", 11, 8, icon_21_icon_rows, icon_21_icon_levels },
    { "普通模式 · 方格核心", 13, 13, icon_22_icon_rows, icon_22_icon_levels },
    { "Codex · 终端标志", 15, 15, icon_23_codex_rows, icon_23_codex_levels },
    { "Claude Code · 放射标志", 15, 15, icon_24_claude_code_rows, icon_24_claude_code_levels },
    { "USB · 有线连接", 13, 15, icon_25_usb_rows, icon_25_usb_levels },
    { "Bluetooth · 蓝牙", 9, 15, icon_26_bluetooth_rows, icon_26_bluetooth_levels },
    { "Battery", 13, 9, battery_rows, NULL },
};

const board_mist_icon_asset_t *board_mist_icon_asset(board_mist_icon_t icon)
{
    return (unsigned)icon < BOARD_MIST_ICON_COUNT ? &s_icons[icon] : NULL;
}

/* Match the handoff's #0B0B0B -> #E0F1F0 grayscale in the panel's wire order. */
uint16_t board_mist_gray_color(uint8_t value)
{
    const unsigned r = 11 + (213U * value + 127U) / 255U;
    const unsigned g = 11 + (230U * value + 127U) / 255U;
    const unsigned b = 11 + (229U * value + 127U) / 255U;
    const uint16_t rgb = (((r * 31U + 127U) / 255U) << 11) |
                         (((g * 63U + 127U) / 255U) << 5) |
                         ((b * 31U + 127U) / 255U);
    return (uint16_t)((rgb << 8) | (rgb >> 8));
}

void board_mist_draw_icon(uint16_t *strip, int width, int height,
                          int strip_y, int strip_lines, board_mist_icon_t icon,
                          int center_x, int center_y, uint8_t pitch,
                          uint8_t brightness)
{
    const board_mist_icon_asset_t *asset = board_mist_icon_asset(icon);
    if (strip == NULL || asset == NULL || pitch < 2 || pitch > 4) {
        return;
    }
    const int cell = pitch - 1;
    const int left = center_x - (asset->width * pitch - 1) / 2;
    const int top = center_y - (asset->height * pitch - 1) / 2;
    for (unsigned row = 0; row < asset->height; ++row) {
        const int y = top + row * pitch;
        if (y >= strip_y + strip_lines || y + cell <= strip_y) {
            continue;
        }
        for (unsigned column = 0; column < asset->width; ++column) {
            if (!(asset->rows[row] & (1U << (asset->width - 1 - column)))) {
                continue;
            }
            const int x = left + column * pitch;
            if (x < 0 || y < 0 || x + cell > width || y + cell > height ||
                !board_display_circular_aperture_contains(x, y, width, height, 125) ||
                !board_display_circular_aperture_contains(x + cell - 1, y, width, height, 125) ||
                !board_display_circular_aperture_contains(x, y + cell - 1, width, height, 125) ||
                !board_display_circular_aperture_contains(x + cell - 1, y + cell - 1, width, height, 125)) {
                continue;
            }
            const unsigned level = asset->levels
                ? asset->levels[row * asset->width + column] : 255u;
            const uint16_t color = board_mist_gray_color(
                (level * brightness + 127U) / 255U);
            for (int dy = 0; dy < cell; ++dy) {
                if (y + dy < strip_y || y + dy >= strip_y + strip_lines) {
                    continue;
                }
                for (int dx = 0; dx < cell; ++dx) {
                    strip[(y + dy - strip_y) * width + x + dx] = color;
                }
            }
        }
    }
}
