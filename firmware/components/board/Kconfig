## firmware/components/board/Kconfig
```kconfig
choice MACROPAD_BOARD
    prompt "Macro pad board target"
    default MACROPAD_BOARD_DEVKIT_BOOT_BUTTON

    config MACROPAD_BOARD_DEVKIT_BOOT_BUTTON
        bool "Engineering dev board using GPIO0 Boot button"
        help
            Safe USB vertical slice. This is not the product PCB pin map.

    config MACROPAD_BOARD_TARGET_REV_A
        bool "WMP-S3-REV-A PCB2 2026-07-18 product PCB"
        help
            Uses the reviewed PCB2 pin map. Physical-board behavior still needs
            bring-up validation before this target is considered production safe.

    config MACROPAD_BOARD_MATRIX12_V1
        bool "WMP-S3 12-key matrix V1 2026-08-10 product PCB"
        help
            Uses the 4-row, 4-column sparse matrix and 12-pixel key-light chain
            extracted from the 2026-08-10 EDA export. This is a separate target;
            it does not change the Rev A seven-key GPIO implementation.

    config MACROPAD_BOARD_MATRIX12_POWER_V2
        bool "WMP-S3 12-key matrix Power V2 product PCB"
        help
            Uses the revised display/matrix pin map, CW2015 fuel gauge,
            active-high GPIO41 encoder/power key, and GPIO47 shutdown request.
            MATRIX12_V1 remains an independent build target.
endchoice
```

## recovery-firmware/firmware/components/codex_micro/Kconfig
```kconfig
menu "Codex Micro compatibility"

    config CODEX_MICRO_BLE_ENABLED
        bool "Enable the unofficial Codex Micro BLE compatibility transport"
        default n
        depends on BT_ENABLED && BT_BLUEDROID_ENABLED && BT_BLE_ENABLED
        help
            Adds a composite BLE HID transport with standard keyboard,
            consumer and mouse reports plus the vendor channel understood by
            ChatGPT Desktop. USB HID + CDC remains enabled and has priority
            for standard input. This compatibility protocol is unofficial and
            may change when the desktop application changes.

    config CODEX_MICRO_USB_ENABLED
        bool "Enable the unofficial Codex Micro native-USB vendor channel"
        default n
        depends on CODEX_MICRO_BLE_ENABLED
        help
            Extends the native USB composite HID interface with the Codex
            vendor Input/Output Report ID 6 and the compatibility VID/PID.
            The BLE compatibility runtime remains available as a fallback,
            while Codex vendor traffic prefers USB whenever it is mounted.

endmenu
```

## recovery-firmware/firmware/sdkconfig.defaults
```kconfig
CONFIG_IDF_TARGET="esp32s3"
CONFIG_PARTITION_TABLE_CUSTOM=y
CONFIG_PARTITION_TABLE_CUSTOM_FILENAME="partitions.csv"
CONFIG_BOOTLOADER_APP_ROLLBACK_ENABLE=y
CONFIG_TINYUSB_CDC_ENABLED=y
CONFIG_TINYUSB_HID_COUNT=1
CONFIG_TINYUSB_CDC_RX_BUFSIZE=512
CONFIG_ESP_CONSOLE_UART_DEFAULT=y
CONFIG_LOG_DEFAULT_LEVEL_INFO=y
CONFIG_COMPILER_OPTIMIZATION_DEBUG=y
```
