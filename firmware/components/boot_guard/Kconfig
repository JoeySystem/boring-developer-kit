## firmware/components/boot_guard/Kconfig
```kconfig
menu "BORING boot guard"

    config WMP_CRASH_FAULT_INJECTION
        bool "TEST ONLY: scripted boot crashes"
        default n
        help
            Never enable for a release. Each boot after a warm reset runs one
            scripted fault 3 s into the main loop: a main-loop stall (task
            watchdog via liveness), then two aborts; the fourth boot is the
            safe-mode boot and later boots run normally. A power-on reset
            restarts the script. Built only with tools/build.sh
            --crash-fault-injection.

endmenu
```

## firmware/components/codex_micro/Kconfig
```kconfig
menu "Codex Micro compatibility"

    config CODEX_MICRO_BLE_ENABLED
        bool "Enable the unofficial Codex Micro BLE compatibility transport"
        default n
        depends on BT_ENABLED && BT_BLUEDROID_ENABLED && BT_BLE_ENABLED
        help
            Adds a composite BLE HID transport with standard keyboard,
            consumer and mouse reports plus the vendor channel understood by
            ChatGPT Desktop. USB HID + CDC remains enabled and has priority
            for standard input. This compatibility protocol is unofficial and
            may change when the desktop application changes.

    config CODEX_MICRO_USB_ENABLED
        bool "Enable the unofficial Codex Micro native-USB vendor channel"
        default n
        depends on CODEX_MICRO_BLE_ENABLED
        help
            Extends the native USB composite HID interface with the Codex
            vendor Input/Output Report ID 6 and the compatibility VID/PID.
            The BLE compatibility runtime remains available as a fallback,
            while Codex vendor traffic prefers USB whenever it is mounted.

    config CODEX_MICRO_BLE_FAULT_INJECTION
        bool "TEST ONLY: scripted BLE start-up faults"
        default n
        depends on CODEX_MICRO_BLE_ENABLED
        help
            Never enable for a release. Each boot after a warm reset runs one
            scripted fault so the BLE start-up recovery can be exercised on a
            healthy board: one failed controller init, three failed inits, a
            panic right after the controller starts, a panic when the HID
            services report ready, then normal boots. A power-on reset
            restarts the script. Built only with tools/build.sh
            --ble-fault-injection.

endmenu
```

## firmware/components/config_protocol/Kconfig
```kconfig
menu "BORING config protocol"

    config WMP_RAM_FAULT_INJECTION
        bool "TEST ONLY: exhaust the DMA-capable internal heap"
        default n
        help
            Never enable for a release. About 20 s after start-up the firmware
            allocates every DMA-capable internal heap block it can and keeps
            them, reproducing a returned unit whose request fingerprints
            failed with that pool exhausted. Use it to check that HELLO,
            GET_STATUS and USB firmware updates still work and how BLE, keys
            and the display behave. Built only with tools/build.sh
            --ram-fault-injection.

endmenu
```
